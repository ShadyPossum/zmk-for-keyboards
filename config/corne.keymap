/*
 * Copyright (c) 2020 The ZMK Contributors
 *
 * SPDX-License-Identifier: MIT
 */

#include <behaviors.dtsi>
#include <dt-bindings/zmk/keys.h>
#include <dt-bindings/zmk/bt.h>
#include "zmk-helpers/helper.h"
#include <dt-bindings/zmk/rgb.h>

// Source desired key-position labels
#include "zmk-helpers/key-labels/42.h"

#define XXX &none
#define ___ &trans

#define BASE 0
#define NAV 1
#define NUM 2
#define UTIL 3
#define SYM 4

// navigation bindings for back/forward and prev tab/next tab
#define BACK &kp LC(LBKT)
#define FWD &kp LC(RBKT)

// hyper and meh keys
#define HYP LS(LC(LA(LGUI)))
#define MEH LS(LC(LALT))

//Keyboard commands
#define SNIP &kp LS(LG(S))

/* ------------------------ general config ----------------------- */

#define QUICK_TAP_MS 175

// smart-layer config
&caps_word {  
    // /delete-property/ ignore-modifiers; // mods deactivate, requires PR #1451
    /delete-property/ ignore-numbers;
    continue-list = <BACKSPACE ENTER DELETE UNDERSCORE MINUS>;
};

// key-repeat config
&key_repeat {
    usage-pages = <HID_USAGE_KEY HID_USAGE_CONSUMER>; // repeat all keys
};

// sticky key aka 'one-shot mods'
&sk {
    release-after-ms = <2000>;
    quick-release;
};

// default layer-tap config
&lt {  
    flavor = "balanced";
    tapping-term-ms = <200>;
    quick-tap-ms = <QUICK_TAP_MS>;
};

#define KEYS_L LT5 LT4 LT3 LT2 LT1 LT0 LM5 LM4 LM3 LM2 LM1 LM0 LB5 LB4 LB3 LB2 LB1 LB0 // left hand
#define KEYS_R RT0 RT1 RT2 RT3 RT4 RT5 RM0 RM1 RM2 RM3 RM4 RM5 RB0 RB1 RB2 RB3 RB4 RB5 // right hand
#define THUMBS LH2 LH1 LH0 RH0 RH1 RH2                                      // thumbs

#define MAKE_HRM(NAME, HOLD, TAP, TRIGGER_POS) \
    ZMK_BEHAVIOR(NAME, hold_tap, \
        flavor = "balanced"; \
        tapping-term-ms = <280>; \
        quick-tap-ms = <QUICK_TAP_MS>; \
        require-prior-idle-ms = <150>; \
        bindings = <HOLD>, <TAP>; \
        hold-trigger-key-positions = <TRIGGER_POS>; \
        hold-trigger-on-release; \
    )
MAKE_HRM(hml, &kp, &kp, KEYS_R THUMBS)  // left-hand HRMs
MAKE_HRM(hmr, &kp, &kp, KEYS_L THUMBS)  // right-hand HRMs

// special HRMs for the right meh key, as it involves a modmorph
MAKE_HRM(hmr_meh, &kp, &comma_morph, KEYS_L THUMBS)


/ {
    macros {
        numSpace: numSpace {
            compatible = "zmk,behavior-macro";
            #binding-cells = <0>;
            bindings
                = <&macro_tap &tog NUM &kp SPACE>
                ;
        };
    };
};


/ {
    behaviors {
        // tap: dot | shift + tap: colon | shift + control + tap: greater_than
        GT_morph: GT_morph {
            compatible = "zmk,behavior-mod-morph";
            #binding-cells = <0>;
            bindings = <&kp COLON>, <&kp GT>;
            mods = <(MOD_LCTL|MOD_RCTL)>;
        };
        dot_morph: dot_morph {
            compatible = "zmk,behavior-mod-morph";
            #binding-cells = <0>;
            bindings = <&kp DOT>, <&GT_morph>;
            mods = <(MOD_LSFT|MOD_RSFT)>;
        };

        // tap: comma | shift + tap: semicolon | shift + control + tap: less_than
        LT_morph: LT_morph {
            compatible = "zmk,behavior-mod-morph";
            #binding-cells = <0>;
            bindings = <&kp SEMICOLON>, <&kp LT>;
            mods = <(MOD_LCTL|MOD_RCTL)>;
        };
        comma_morph: comma_morph {
            compatible = "zmk,behavior-mod-morph";
            #binding-cells = <0>;
            bindings = <&kp COMMA>, <&LT_morph>;
            mods = <(MOD_LSFT|MOD_RSFT)>;
        };
        
        // tap: qmark | shift + tap: excl
        qexcl: qexcl {
            compatible = "zmk,behavior-mod-morph";
            #binding-cells = <0>;
            bindings = <&kp QMARK>, <&kp EXCL>;
            mods = <(MOD_LSFT|MOD_RSFT)>;
        };
    };
    keymap {
        compatible = "zmk,keymap";
        default_layer { // Alphabet
            display-name = "Base";
            bindings = <
            &hmr &gresc TAB       &kp Q         &kp W         &kp E         &kp R         &kp T              &kp Y  &kp U         &kp I           &kp O        &kp P                 &kp BSPC   
            &kp LC(BSPC)  &hml LCTRL A  &hml LALT S   &hml LGUI D   &hml LSHFT F  &kp G              &kp H  &hmr RSHFT J  &hmr RGUI K     &hmr LALT L  &hmr RCTRL SEMICOLON  &kp APOS
            &kp CAPS    &hml LC(Z) Z  &hml LC(X) X  &hml LC(C) C  &hml LC(V) V  &kp B                &kp N  &kp M         &kp COMMA       &kp DOT      &kp SLASH             SNIP
                                            &tog NAV     &sl SYM    &kp SPACE              &kp RET    &tog NUM    &sk LSHIFT
            >;
        };
        nav_layer { 
            display-name = "Nav";
            bindings = <
            ___        ___       ___       ___     &rgb_ug RGB_BRI      &rgb_ug RGB_BRI                &kp INS  &kp HOME   &kp UP    &kp END    &kp PAGE_UP    ___
            ___        ___       ___       ___     &rgb_ug RGB_SPI      &rgb_ug RGB_SPD                ___      &kp LEFT   &kp DOWN  &kp RIGHT  &kp PAGE_DOWN  ___
            ___        ___       ___       ___     &rgb_ug RGB_EFF      &rgb_ug RGB_EFR                ___      &kp GRAVE  ___       &kp FSLH   ___            ___
                                     &tog NAV       &rgb_ug RGB_TOG           ___                      &kp RET       &kp BSPC          &kp DEL
            >;
        }; 
        num_layer {
            display-name = "Num";
            bindings = <
             ___      &kp PLUS     &kp N7       &kp N8          &kp  N9         &kp STAR                   ___           ___               ___             ___           ___         ___
             ___      &kp EQUAL    &kp N4       &kp N5          &kp  N6         &kp N0                     ___           &kp LSHFT         &kp LGUI        &kp LALT      &kp LCTRL   ___
            &kp LBKT  &kp MINUS    &kp N1       &kp N2          &kp  N3         &kp FSLH                   ___           &kp HYP           &kp MEH         ___           ___         &kp RBKT
                                      &kp BSLH        &kp  DOT        &numSpace                             ___           &tog NUM               ___
            >;
        };
        util_layer {
            display-name = "Util";
            bindings = <
            &bt BT_SEL 0 &bt BT_SEL 1 &bt BT_SEL 2    &bt BT_CLR      ___                ___           ___               &kp C_VOL_UP    ___           ___
            &kp LCTRL     &kp LALT     &kp LGUI       &kp LSHFT      ___                ___           ___                &kp C_VOL_DN    ___           ___ 
    ___     ___          ___          ___             &kp HYP        ___                ___           ___               ___             ___           ___             ___
                                      ___             ___             ___                ___           ___               &kp C_MUTE
            >;
        };  
        symbol_layer { // Symbols
            display-name = "Symbols";
            bindings = <
            ___    &kp APOS   &kp LT    &kp GT    &kp LS(APOS)   &kp DOT              &kp AMPS   &kp SEMICOLON  &kp LBKT  &kp RBKT  &kp PRCNT  ___   
            ___    &kp EXCL   &kp MINUS &kp PLUS  &kp EQUAL      &kp HASH             &kp PIPE   &kp COLON      &kp LPAR  &kp RPAR  &kp QMARK  ___
            ___    &kp CARET  &kp FSLH  &kp STAR  &kp BACKSLASH   ___                 &kp TILDE  &kp DOLLAR     &kp LBRC  &kp RBRC  &kp AT     ___
                                             ___  ___  &kp SPACE             &kp RET       &tog NUM       ___
            >;
        };
    };
};
    
/* --------------------------------- combos --------------------------------- */
/*                                      42 KEY MATRIX / LAYOUT MAPPING

  ╭────────────────────────┬────────────────────────╮ ╭─────────────────────────┬─────────────────────────╮
  │  0   1   2   3   4   5 │  6   7   8   9  10  11 │ │ LT5 LT4 LT3 LT2 LT1 LT0 │ RT0 RT1 RT2 RT3 RT4 RT5 │
  │ 12  13  14  15  16  17 │ 18  19  20  21  22  23 │ │ LM5 LM4 LM3 LM2 LM1 LM0 │ RM0 RM1 RM2 RM3 RM4 RM5 │
  │ 24  25  26  27  28  29 │ 30  31  32  33  34  35 │ │ LB5 LB4 LB3 LB2 LB1 LB0 │ RB0 RB1 RB2 RB3 RB4 RB5 │
  ╰───────────╮ 36  37  38 │ 39  40  41 ╭───────────╯ ╰───────────╮ LH2 LH1 LH0 │ RH0 RH1 RH2 ╭───────────╯
              ╰────────────┴────────────╯                         ╰─────────────┴─────────────╯             */
// use global-quick-tap-ms for combos (requires PR 1387)